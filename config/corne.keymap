/* source keypos definitions */
#include "../zmk-nodefree-config/keypos_def/keypos_42keys.h"

#define NAV 1

/* map Corne's extra keys */
#define X_LT &kp TAB
#define X_LM &kp LSHIFT
#define X_LB &kp LCTRL
#define X_LH &none

#define X_RT &kp ESC
#define X_RM &kp GRAVE
#define X_RB &kp BSLH
#define X_RH &none

/* activate bluetooth */
#define CONFIG_WIRELESS 1

/* source the main keymap */
#include "base.keymap"
